## meta-rauc-ti-am335x/conf/layer.conf
```bitbake
# We have a conf and classes directory, add to BBPATH
BBPATH .= ":${LAYERDIR}"

# We have recipes-* directories, add to BBFILES
BBFILES += "${LAYERDIR}/recipes-*/*/*.bb \
            ${LAYERDIR}/recipes-*/*/*.bbappend"

BBFILE_COLLECTIONS += "meta-rauc-ti-am335x"
BBFILE_PATTERN_meta-rauc-ti-am335x = "^${LAYERDIR}/"
BBFILE_PRIORITY_meta-rauc-ti-am335x = "6"

LAYERDEPENDS_meta-rauc-ti-am335x = "core rauc"
LAYERSERIES_COMPAT_meta-rauc-ti-am335x = "kirkstone"
```
